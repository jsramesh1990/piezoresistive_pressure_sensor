/dts-v1/;
/ {
  fragment@0 {
    target-path = "/soc/i2c@ff000000"; /* replace with your board's i2c node */
    __overlay__ {
      status = "okay";
      ads1115@48 {
        compatible = "ti,ads1115";
        reg = <0x48>;
        vref-supply = <&vdd_3v3>;
        #io-channel-cells = <1>;
    };
  };
};
